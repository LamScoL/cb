## config/boards/shields/chordboard/Kconfig.shield
```kconfig
config SHIELD_CHORDBOARD
	def_bool $(shields_list_contains, ChordBoard)

config ZMK_HID_REPORT_TYPE_NKRO
	bool "Full N-Key Roll Over (NKRO) HID Report"
```
